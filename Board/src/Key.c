#include "common.h"
#include "oled.h"
#include "Key.h"
#include "MK60_gpio.h"
#include "MK60_flash.h"
#include "FIRE_OV7725_Eagle.h"
extern int main_control;

extern uint8 go_flag;

//uint16 x,y;
//float Kp_Duoji, Ki_Duoji, Kd_Duoji;
uint16 DuiBiDu, BaiPingHeng, DaiDing;
//uint16 Kp_Dianji, Ki_Dianji, Kd_Dianji;
uint16 ZhiDao, WanDao, ZhiJiao;

uint16 Kp_Duoji_u, Ki_Duoji_u, Kd_Duoji_u;

uint8 ledDisplay =0;//开启图像显示标志
uint8 menu_num=0;          //菜单显示标志
uint8 menu_num_last=1;     //上次菜单选项
uint8 sel_num=1;           //选择返显标志
uint8 sel_num_last=1;      //上次选择返显标志
uint8 NumberScale=1;  //数值数量级

uint8 Zero_flag = 0,Reddy_flag = 0;

uint8 Flag_Turn = 0;//直角转向标志

extern uint8 img[CAMERA_W*CAMERA_H];

//初始化
void Key_Init()
{
     gpio_init (PTE0, GPI,0);
     gpio_init (PTE1, GPI,0);
     gpio_init (PTE2, GPI,0);
     gpio_init (PTE3, GPI,0);
     
     port_init_NoALT(PTE0, PULLUP);         //保持复用不变，仅仅改变配置选项
     port_init_NoALT(PTE1, PULLUP);         //保持复用不变，仅仅改变配置选项
     port_init_NoALT(PTE2, PULLUP);         //保持复用不变，仅仅改变配置选项
     port_init_NoALT(PTE3, PULLUP);         //保持复用不变，仅仅改变配置选项
     
     /*** OLED显示主菜单 ***/
     //      主菜单      //
     //1、图像和参数显示 //
     //2、参数设置       //
     //3、保存到Flash    //
     
     LCD_Init();//OLED初始化
     	
     LCD_Print(0,0,"oled is ok");
     
     //LED_PrintImage((uint8 *)LOGO, 64, 128);
    // Draw_BMP(0,0,127,7,(uint8 *)LOGO);
     //LCD_DLY_ms(1000);
     //LCD_DLY_ms(1000);
     //LCD_DLY_ms(1000);
     //LCD_DLY_ms(1000);
     //LCD_DLY_ms(1000);
     
     
	LCD_DLY_ms(1000);
     
     flash_init();//Flash初始化
     LCD_DLY_ms(20);
//printf("success");     
    
     Kp_Duoji_u = flash_read(125,0,uint16);
     Ki_Duoji_u = flash_read(125,4,uint16);
     Kd_Duoji_u = flash_read(125,8,uint16);

     DuiBiDu = flash_read(126,0,uint16);
     BaiPingHeng = flash_read(126,4,uint16);
     DaiDing ;//= flash_read(126,8,uint16);
     
     ZhiDao = flash_read(127,0,uint16);
     WanDao = flash_read(127,4,uint16);
     ZhiJiao = flash_read(127,8,uint16);
     
     //Exchange_1();//整形转为浮点型
}

 

/*------------------------------------------------
                 菜单显示函数
------------------------------------------------*/
void Menu_display(void)
{
     if(menu_num_last != menu_num || sel_num_last != sel_num)
     {
          if(menu_num_last!=menu_num) LCD_Fill(0x00);//黑屏
          if(sel_num <= 0) sel_num = 3;
          if(sel_num >= 4) sel_num = 1;
          menu_num_last = menu_num;
          sel_num_last = sel_num;

          switch(menu_num_last)
          {
               case 0:
                    OLED_Print(5,0,sel_num==0,"     主菜单");
                    OLED_Print(5,2,sel_num==1,"1.图像与参数显示 ");
                    OLED_Print(5,4,sel_num==2,"2.设置参数");
                    OLED_Print(5,6,sel_num==3,"3.其他设置");
                    break;
               case 1:
                    OLED_Print(5,0,sel_num==0,"    设置参数");
                    OLED_Print(5,2,sel_num==1,"1.舵机PID");
                    OLED_Print(5,4,sel_num==2,"2.图像参数");
                    OLED_Print(5,6,sel_num==3,"3.速度设置");
                    break;
               case 2:
                    OLED_Print(5,0,sel_num==0,"    舵机PID");
                    OLED_Print(5,2,sel_num==1,"舵机P:");
                    OLED_Print(5,4,sel_num==2,"舵机I:");
                    OLED_Print(5,6,sel_num==3,"舵机D:");
                    break;
               case 3:
                    OLED_Print(5,0,sel_num==0,"    图像参数");
                    OLED_Print(5,2,sel_num==1,"1.DuiBi:");
                    OLED_Print(5,4,sel_num==2,"2.BaiPH:");
                    OLED_Print(5,6,sel_num==3,"3.确定");
                    break;
               case 4:
                    OLED_Print(5,0,sel_num==0,"    速度设置");
                    OLED_Print(5,2,sel_num==1,"直道速度:");
                    OLED_Print(5,4,sel_num==2,"弯道速度:");
                    OLED_Print(5,6,sel_num==3,"直角速度:");
                    break;
               
               case 5://采集图像，显示参数
                 /*
                 
                 
                 
                    OLED_Print(5,0,sel_num==0,"             ");
                    OLED_Print(5,2,sel_num==0,"    图       ");
                    OLED_Print(5,4,sel_num==0,"             ");
                    OLED_Print(5,6,sel_num==0,"             ");
                 
                 */
                 ledDisplay = 1;
                // LED_PrintImage(img,60,80);                          //绘制图像
                    break;
               case 6:
                    OLED_Print(5,0,sel_num==0,"仅开机有效");
                    OLED_Print(5,2,sel_num==1,"1.直角Left");
                    OLED_Print(5,4,sel_num==2,"2.直角Right");
                    OLED_Print(5,6,sel_num==3,"3.直角L and R");
                    break;   
  
               default:
                    break;
          }

     }
}

/*------------------------------------------------
                 按键扫描函数
------------------------------------------------*/
void Keyscan(void)
{
     //extern u8 IntegrationTime;
     
     if( menu_num<2 || menu_num>4 )
     {
          if(K3 == 0) 
          {
               while(!K3);
               sel_num--;
          }
          if(K2 == 0) 
          {
               while(!K2);
               sel_num++;
          }
     }


/********************* K2 , K3为调节键 *******************/     
     else 
     {
          if(Kp_Duoji_u >= 9998)
          {
               Kp_Duoji_u = 9998;
          }
          else if(Kp_Duoji_u <= 1)
          {
               Kp_Duoji_u = 1;
          }
          
          if(Ki_Duoji_u >= 9998)
          {
               Ki_Duoji_u = 9998;
          }
          else if(Ki_Duoji_u <= 1)
          {
               Ki_Duoji_u = 1;
          }
          
          if(Kd_Duoji_u >= 9998)
          {
               Kd_Duoji_u = 9998;
          }          
          else if(Kd_Duoji_u <= 1)
          {
               Kd_Duoji_u = 1;
          }
          
          if(ZhiDao >= 998)
          {
               ZhiDao = 998;
          }
          else if(ZhiDao <= 1)
          {
               ZhiDao = 1;
          }
          
          if(WanDao > 500)
          {
               WanDao = 500;
          }
          else if(WanDao <= 1)
          {
               WanDao = 1;
          }
          
          if(DuiBiDu >= 255)
          {
               DuiBiDu = 0;
          }
          else if(DuiBiDu <= 0)
          {
               DuiBiDu = 255;
          }
          
          if(BaiPingHeng >= 255)
          {
               BaiPingHeng = 0;
          }
          else if(BaiPingHeng <= 0)
          {
               BaiPingHeng = 255;
          }
       
          if(K3 == 0) //按下上
          {    
               switch(menu_num)
               {
                    case 2: 
                    {
                         switch(sel_num)
                         {
                              case 1:Kp_Duoji_u += NumberScale;break;
                              case 2:Ki_Duoji_u += NumberScale;break;
                              case 3:Kd_Duoji_u += NumberScale;break;
                         }
                         break;
                    }
                    case 3: 
                    {
                         switch(sel_num)
                         {
                              case 1:DuiBiDu += NumberScale;break;
                              case 2:BaiPingHeng += NumberScale;break;
                             // case 3:DaiDing += NumberScale;break;
                         }
                         break;
                    }
                    case 4: 
                    {
                         switch(sel_num)
                         {
                              case 1:ZhiDao+=NumberScale;break;
                              case 2:WanDao+=NumberScale;break;
                              case 3:ZhiJiao+=NumberScale;break;
                         }
                         break;
                    }
               }
               
          }
          else if(K2 == 0)
          {  
               switch(menu_num)
               {
                    case 2: 
                    {
                         switch(sel_num)
                         {
                              case 1:Kp_Duoji_u -=NumberScale;break;
                              case 2:Ki_Duoji_u -=NumberScale;break;
                              case 3:Kd_Duoji_u -=NumberScale;break;
                         }
                         break;
                    }
                    case 3: 
                    {
                         switch(sel_num)
                         {
                              case 1:DuiBiDu -= NumberScale;break;
                              case 2:BaiPingHeng -= NumberScale;break;
                            //  case 3:DaiDing -= NumberScale;break;
                         }
                         break;
                    }
                    case 4: 
                    {
                         switch(sel_num)
                         {
                              case 1:ZhiDao-=NumberScale;break;
                              case 2:WanDao-=NumberScale;break;
                              case 3:ZhiJiao-=NumberScale;break;
                         }
                         break;
                    }
               }
          }
     }


/******************* K4为确定键 *************************/
     if(K4 == 0)//按下确定
     {
          //PTC0_OUT=1;
          //OLED_Fill(0x00);//黑屏
          switch(menu_num)
          {
               case 0:
               {
                    switch(sel_num)
                    {
                         case 1:menu_num=5;break;//采集图像
                         case 2:menu_num=1;break;//参数设置
                         case 3:menu_num=6;break;//其他设置
                    }
                    break;
               }

               case 1:
               {
                    switch(sel_num)
                    {
                         case 1:menu_num=2;break;//舵机PID
                         case 2:menu_num=3;break;//图像参数
                         case 3:menu_num=4;break;//其他参数
                    }
                    break;
               }
               case 2:
               {
                    menu_num = 0;
                    DisableInterrupts;
                    
                    //Exchange_2();//浮点转整形，和单位转换
                    
                    flash_erase_sector(125);
                    flash_write(125, 0, Kp_Duoji_u);
                    flash_write(125, 4, Ki_Duoji_u);
                    flash_write(125, 8, Kd_Duoji_u);
                    
                    //Exchange_1();
                    
                    //Kp_Duoji = ((float)Kp_Duoji_u)/100;
                    //Kd_Duoji = ((float)Kd_Duoji_u)/100;
                    //x = (uint16)(Kp_Duoji*100);
                    //y = (uint16)(Kd_Duoji*100);
                    
                    
                    //printf("Kp_Duoji_u: %d\n\r",Kp_Duoji_u);
                    //printf("Kd_Duoji_u: %d\n\r",Kd_Duoji_u);                    
                    //printf("Kp_Duoji: %d\n\r",x);
                    //printf("Kd_Duoji: %d\n\r",y);
                                       
                    EnableInterrupts;
                    
                    break;
               }
               
               case 3:
               {
                    menu_num = 0;
                    DisableInterrupts;
                    flash_erase_sector(126);
                    flash_write(126, 0, DuiBiDu);
                    flash_write(126, 4, BaiPingHeng);
                    //flash_write(126, 8, DaiDing);
                    EnableInterrupts;
                    break;
               }
               case 4:
               {
                    menu_num = 0;
                    DisableInterrupts;
                    flash_erase_sector(127);
                    flash_write(127, 0, ZhiDao);
                    flash_write(127, 4, WanDao);
                    flash_write(127, 8, ZhiJiao);
                    EnableInterrupts;
                    
                    //printf("ZhiDao: %d\n\r",ZhiDao);
                    
                    
                    break;
               }
               case 6:
               {
				   if(go_flag == 0)
				   {
                    
                   
					
                    switch(sel_num)
                    {
                         case 1:Flag_Turn = 1; main_control =1;break;//直角左转
                         case 2:Flag_Turn = 2; main_control =1;break;//直角右转
                         case 3:Flag_Turn = 3; main_control =1;break;//直角左右转
                    }
					menu_num = 0; 
                    LCD_Print(0,0,"oled is ok");
					 systick_delay_ms(50);
					LCD_CLS();
				   }
                    break;
               }
               //case 6:menu_num = 0; LCD_Print(0,0,"oled is ok");main_control =1;break;
               default:
                    break;   
          }
          while(!K4);
          //PTC0_OUT=0;
     }
     

/************* K1为返回键 *********************/
     if(K1 == 0)//按下返回
     {
          //PTC0_OUT=1;
          //sel_num=1;
          //OLED_Fill(0x00);//黑屏
          switch(menu_num)
          {
               case 0:ledDisplay = 0;break;
               case 1:menu_num=0;sel_num=1;ledDisplay = 0;break;
               case 2:sel_num++;ledDisplay = 0;break;
               case 3:sel_num++;ledDisplay = 0;break;
               case 4:sel_num++;ledDisplay = 0;break;
               case 5:menu_num=0;sel_num=1;ledDisplay = 0;break;
               case 6:menu_num=0;sel_num=1;ledDisplay = 0;break;
                    
               default:break;
          }  
          while(!K1);
          //PTC0_OUT=0;
     }
}

//-------------显示--------------
void Display()
{    
     switch(menu_num)
     {
          case 2: 
          { 
               LCD_P8x16uint16(90,2,Kp_Duoji_u); 
               LCD_P8x16uint16(90,4,Ki_Duoji_u); 
               LCD_P8x16uint16(90,6,Kd_Duoji_u);
               break;
          }
          case 3: 
          {
               LCD_P8x16uint16(90,2,DuiBiDu); 
               LCD_P8x16uint16(90,4,BaiPingHeng); 
               //LCD_P8x16uint16(90,6,DaiDing);
            
                
               break;
          }
          case 4: 
          {
               LCD_P8x16uint16(90,2,ZhiDao);
               LCD_P8x16uint16(90,4,WanDao);
               LCD_P8x16uint16(90,6,ZhiJiao);
               break;
          }
          
          default: 
               break;      
       
     }
}

void Key_Control()
{
     Menu_display();
     Keyscan();
     Display();
}


const byte LOGO[] =
{

0x00,0x00,0x00,0x00,0x00,0x00,0x00,0x00,0x00,0x00,0x00,0x00,0x00,0x00,0x00,0x00,
0x00,0x00,0x00,0x00,0x00,0x00,0x00,0x00,0x00,0x00,0x00,0x00,0x00,0x00,0x00,0x00,
0x00,0x00,0x00,0x00,0x00,0x00,0x00,0x00,0x00,0x00,0x00,0x00,0x00,0x80,0x80,0xC0,
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0x00,0x00,0x00,0x00,0x00,0x00,0x00,0x00,0x00,0x00,0x00,0x00,0x00,0x00,0x00,0x00,/*"C:\Users\Administrator\Desktop\LOGO.bmp",0*/
};